# file: HS_ATC_Cubeide.ioc
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ADC1.Channel-0\#ChannelRegularConversion=ADC_CHANNEL_10
ADC1.Channel-1\#ChannelRegularConversion=ADC_CHANNEL_11
ADC1.Channel-2\#ChannelRegularConversion=ADC_CHANNEL_12
ADC1.Channel-3\#ChannelRegularConversion=ADC_CHANNEL_13
ADC1.Channel-4\#ChannelRegularConversion=ADC_CHANNEL_14
ADC1.ContinuousConvMode=ENABLE
ADC1.DMAContinuousRequests=ENABLE
ADC1.NbrOfConversion=5
ADC1.NbrOfConversionFlag=1
ADC1.Rank-0\#ChannelRegularConversion=1
ADC1.Rank-1\#ChannelRegularConversion=2
ADC1.Rank-2\#ChannelRegularConversion=3
ADC1.Rank-3\#ChannelRegularConversion=4
ADC1.Rank-4\#ChannelRegularConversion=5
ADC1.SamplingTime-0\#ChannelRegularConversion=ADC_SAMPLETIME_480CYCLES
ADC1.SamplingTime-1\#ChannelRegularConversion=ADC_SAMPLETIME_84CYCLES
ADC1.SamplingTime-2\#ChannelRegularConversion=ADC_SAMPLETIME_84CYCLES
ADC1.SamplingTime-3\#ChannelRegularConversion=ADC_SAMPLETIME_84CYCLES
ADC1.SamplingTime-4\#ChannelRegularConversion=ADC_SAMPLETIME_84CYCLES
ADC1.ScanConvMode=ENABLE
ADC1.master=1
CAN1.BS1=CAN_BS1_7TQ
CAN1.BS2=CAN_BS2_2TQ
CAN1.CalculateBaudRate=500000
CAN1.CalculateTimeBit=2000
CAN1.CalculateTimeQuantum=200.0
CAN1.Prescaler=9
CAN1.RFLM=DISABLE
CAN2.BS1=CAN_BS1_7TQ
CAN2.BS2=CAN_BS2_2TQ
CAN2.CalculateBaudRate=500000
CAN2.CalculateTimeBit=2000
CAN2.CalculateTimeQuantum=200.0
CAN2.Prescaler=9
Dma.ADC1.2.Direction=DMA_PERIPH_TO_MEMORY
Dma.ADC1.2.FIFOMode=DMA_FIFOMODE_DISABLE
Dma.ADC1.2.Instance=DMA2_Stream0
Dma.ADC1.2.MemDataAlignment=DMA_MDATAALIGN_HALFWORD
Dma.ADC1.2.MemInc=DMA_MINC_ENABLE
Dma.ADC1.2.Mode=DMA_CIRCULAR
Dma.ADC1.2.PeriphDataAlignment=DMA_PDATAALIGN_HALFWORD
Dma.ADC1.2.PeriphInc=DMA_PINC_DISABLE
Dma.ADC1.2.Priority=DMA_PRIORITY_LOW
Dma.Request0=SDIO_TX
Dma.Request1=SDIO_RX
Dma.Request2=ADC1
Dma.SDIO_RX.1.Direction=DMA_PERIPH_TO_MEMORY
Dma.SDIO_RX.1.FIFOMode=DMA_FIFOMODE_ENABLE
Dma.SDIO_RX.1.FIFOThreshold=DMA_FIFO_THRESHOLD_FULL
Dma.SDIO_RX.1.Instance=DMA2_Stream6
Dma.SDIO_RX.1.MemBurst=DMA_MBURST_INC4
Dma.SDIO_RX.1.MemDataAlignment=DMA_MDATAALIGN_WORD
Dma.SDIO_RX.1.MemInc=DMA_MINC_ENABLE
Dma.SDIO_RX.1.Mode=DMA_PFCTRL
Dma.SDIO_RX.1.PeriphBurst=DMA_PBURST_INC4
Dma.SDIO_RX.1.PeriphDataAlignment=DMA_PDATAALIGN_WORD
Dma.SDIO_RX.1.PeriphInc=DMA_PINC_DISABLE
Dma.SDIO_RX.1.Priority=DMA_PRIORITY_LOW
Dma.SDIO_TX.0.Direction=DMA_MEMORY_TO_PERIPH
Dma.SDIO_TX.0.FIFOMode=DMA_FIFOMODE_ENABLE
Dma.SDIO_TX.0.FIFOThreshold=DMA_FIFO_THRESHOLD_FULL
Dma.SDIO_TX.0.Instance=DMA2_Stream3
Dma.SDIO_TX.0.MemBurst=DMA_MBURST_INC4
Dma.SDIO_TX.0.MemDataAlignment=DMA_MDATAALIGN_WORD
Dma.SDIO_TX.0.MemInc=DMA_MINC_ENABLE
Dma.SDIO_TX.0.Mode=DMA_PFCTRL
Dma.SDIO_TX.0.PeriphBurst=DMA_PBURST_INC4
Dma.SDIO_TX.0.PeriphDataAlignment=DMA_PDATAALIGN_WORD
Dma.SDIO_TX.0.PeriphInc=DMA_PINC_DISABLE
Dma.SDIO_TX.0.Priority=DMA_PRIORITY_LOW
FATFS.BSP.number=1
FATFS.USE_DMA_CODE_SD=1
FATFS._FS_NORTC=0
FATFS._FS_TINY=0
FATFS._USE_LFN=1
FATFS0.BSP.STBoard=false
FATFS0.BSP.api=Unknown
FATFS0.BSP.i2caddr=0
FATFS0.BSP.instance=PD3
FATFS0.BSP.ip=GPIO
FATFS0.BSP.mode=Input
FATFS0.BSP.name=Detect_SDIO
FATFS0.BSP.solution=PD3
FMC.AddressSetupTime1=1
FMC.BusTurnAroundDuration1=1
FMC.DataSetupTime1=1
FMC.ExtendedAddressSetupTime1=1
FMC.ExtendedBusTurnAroundDuration1=1
FMC.ExtendedDataSetupTime1=1
FMC.ExtendedMode1=FMC_EXTENDED_MODE_ENABLE
FMC.WriteOperation1=FMC_WRITE_OPERATION_ENABLE
Mcu.Family=STM32F4
Mcu.Name=STM32F429B(E-G-I)Tx
Mcu.Package=LQFP208
NVIC.CAN1_RX0_IRQn=true\:0\:0\:false\:false\:true\:true\:true\:true
NVIC.CAN2_RX0_IRQn=true\:0\:0\:false\:false\:true\:true\:true\:true
NVIC.DMA2_Stream0_IRQn=true\:0\:0\:false\:false\:true\:false\:true\:true
NVIC.DMA2_Stream3_IRQn=true\:0\:0\:false\:false\:true\:false\:true\:true
NVIC.DMA2_Stream6_IRQn=true\:0\:0\:false\:false\:true\:false\:true\:true
NVIC.PriorityGroup=NVIC_PRIORITYGROUP_4
NVIC.SDIO_IRQn=true\:0\:0\:false\:false\:true\:true\:true\:true
NVIC.TIM6_DAC_IRQn=true\:0\:0\:false\:false\:true\:true\:true\:true
NVIC.TIM7_IRQn=true\:0\:0\:false\:false\:true\:true\:true\:true
NVIC.UART7_IRQn=true\:0\:0\:false\:false\:true\:true\:true\:true
NVIC.UART8_IRQn=true\:0\:0\:false\:false\:true\:true\:true\:true
NVIC.USART1_IRQn=true\:0\:0\:false\:false\:true\:true\:true\:true
NVIC.USART2_IRQn=true\:0\:0\:false\:false\:true\:true\:true\:true
NVIC.USART3_IRQn=true\:0\:0\:false\:false\:true\:true\:true\:true
NVIC.USART6_IRQn=true\:0\:0\:false\:false\:true\:true\:true\:true
PA0/WKUP.GPIO_Label=EQEP3A
PA0/WKUP.GPIO_Speed=GPIO_SPEED_FREQ_VERY_HIGH
PA0/WKUP.Signal=S_TIM2_CH1_ETR
PA1.GPIO_Label=EQEP3B
PA1.GPIO_Speed=GPIO_SPEED_FREQ_VERY_HIGH
PA1.Signal=S_TIM2_CH2
PA11.GPIO_Label=SCIA_RE
PA11.Signal=GPIO_Output
PA12.GPIO_Label=SCIB_RE
PA12.Signal=GPIO_Output
PA2.GPIO_Label=SCIB_TX
PA2.Mode=Asynchronous
PA2.Signal=USART2_TX
PA3.GPIO_Label=SCIB_RX
PA3.Mode=Asynchronous
PA3.Signal=USART2_RX
PA4.GPIO_Label=ROM_CS
PA4.Signal=GPIO_Output
PA5.GPIO_Label=ROM_SCK
PA5.Mode=Full_Duplex_Master
PA5.Signal=SPI1_SCK
PA6.GPIO_Label=ROM_MISO
PA6.GPIO_PuPd=GPIO_PULLUP
PA6.Mode=Full_Duplex_Master
PA6.Signal=SPI1_MISO
PA7.GPIO_Label=ROM_MOSI
PA7.Mode=Full_Duplex_Master
PA7.Signal=SPI1_MOSI
PA8.GPIO_Label=EQEP1A
PA8.GPIO_Speed=GPIO_SPEED_FREQ_VERY_HIGH
PA8.Signal=S_TIM1_CH1
PA9.GPIO_Label=EQEP1B
PA9.GPIO_Speed=GPIO_SPEED_FREQ_VERY_HIGH
PA9.Signal=S_TIM1_CH2
PB0.GPIO_Label=ROM_WP
PB0.Signal=GPIO_Output
PB10.GPIO_Label=SCIC_TX
PB10.Mode=Asynchronous
PB10.Signal=USART3_TX
PB11.GPIO_Label=SCIC_RX
PB11.Mode=Asynchronous
PB11.Signal=USART3_RX
PB12.Mode=CAN_Activate
PB12.Signal=CAN2_RX
PB13.Mode=CAN_Activate
PB13.Signal=CAN2_TX
PB6.GPIO_Label=SCIA_TX
PB6.Mode=Asynchronous
PB6.Signal=USART1_TX
PB7.GPIO_Label=SCIA_RX
PB7.Mode=Asynchronous
PB7.Signal=USART1_RX
PB8.Mode=CAN_Activate
PB8.Signal=CAN1_RX
PB9.Mode=CAN_Activate
PB9.Signal=CAN1_TX
PC0.GPIO_Label=BAT_CHECK
PC0.Signal=ADCx_IN10
PC1.GPIO_Label=TORQUE_AD_MT1
PC1.Signal=ADCx_IN11
PC10.Mode=SD_4_bits_Wide_bus
PC10.Signal=SDIO_D2
PC11.Mode=SD_4_bits_Wide_bus
PC11.Signal=SDIO_D3
PC12.Mode=SD_4_bits_Wide_bus
PC12.Signal=SDIO_CK
PC2.GPIO_Label=TORQUE_AD_MT2
PC2.Signal=ADCx_IN12
PC3.GPIO_Label=TORQUE_AD_MT3
PC3.Signal=ADCx_IN13
PC4.GPIO_Label=TORQUE_AD_MT4
PC4.Signal=ADCx_IN14
PC6.GPIO_Label=EQEP2A
PC6.GPIO_Speed=GPIO_SPEED_FREQ_VERY_HIGH
PC6.Signal=S_TIM3_CH1
PC7.GPIO_Label=EQEP2B
PC7.GPIO_Speed=GPIO_SPEED_FREQ_VERY_HIGH
PC7.Signal=S_TIM3_CH2
PC8.Mode=SD_4_bits_Wide_bus
PC8.Signal=SDIO_D0
PC9.Mode=SD_4_bits_Wide_bus
PC9.Signal=SDIO_D1
PD0.Signal=FMC_D2_DA2
PD1.Signal=FMC_D3_DA3
PD12.GPIO_Label=EQEP4A
PD12.Signal=S_TIM4_CH1
PD13.GPIO_Label=EQEP4B
PD13.Signal=S_TIM4_CH2
PD14.Signal=FMC_D0_DA0
PD15.Signal=FMC_D1_DA1
PD2.Mode=SD_4_bits_Wide_bus
PD2.Signal=SDIO_CMD
PD3.GPIO_Label=SC_CD
PD3.Signal=GPIO_Input
PD4.Signal=FMC_NOE
PD5.Signal=FMC_NWE
PD7.Mode=NorPsramChipSelect1_1
PD7.Signal=FMC_NE1
PD8.GPIO_Label=MT_DAC_EN
PD8.GPIO_Speed=GPIO_SPEED_FREQ_VERY_HIGH
PD8.PinState=GPIO_PIN_SET
PD8.Signal=GPIO_Output
PE0.GPIO_Label=SCID_RX
PE0.Mode=Asynchronous
PE0.Signal=UART8_RX
PE1.GPIO_Label=SCID_TX
PE1.Mode=Asynchronous
PE1.Signal=UART8_TX
PE10.Signal=FMC_D7_DA7
PE2.GPIO_Label=MT3_ABS_SCK
PE2.GPIO_Speed=GPIO_SPEED_FREQ_HIGH
PE2.Signal=GPIO_Output
PE5.GPIO_Label=MT3_ABS_DATA
PE5.Signal=GPIO_Input
PE7.Signal=FMC_D4_DA4
PE8.Signal=FMC_D5_DA5
PE9.Signal=FMC_D6_DA6
PF0.Signal=FMC_A0
PF1.Signal=FMC_A1
PF10.GPIO_Label=MT3_ERR
PF10.Signal=GPIO_Input
PF11.GPIO_Label=MT4_ERR
PF11.Signal=GPIO_Input
PF12.GPIO_Label=SPARE_IN1
PF12.Signal=GPIO_Input
PF13.GPIO_Label=SPARE_IN2
PF13.Signal=GPIO_Input
PF14.GPIO_Label=SPARE_IN3
PF14.Signal=GPIO_Input
PF15.GPIO_Label=SPARE_IN4
PF15.Signal=GPIO_Input
PF2.Signal=FMC_A2
PF3.Signal=FMC_A3
PF4.Signal=FMC_A4
PF6.GPIO_Label=SCIF_RX
PF6.Mode=Asynchronous
PF6.Signal=UART7_RX
PF7.GPIO_Label=SCIF_TX
PF7.Mode=Asynchronous
PF7.Signal=UART7_TX
PF8.GPIO_Label=MT1_ERR
PF8.Signal=GPIO_Input
PF9.GPIO_Label=MT2_ERR
PF9.Signal=GPIO_Input
PG0.GPIO_Label=SPARE_IN5
PG0.Signal=GPIO_Input
PG1.GPIO_Label=SPARE_IN6
PG1.Signal=GPIO_Input
PG10.GPIO_Label=DIRECT_OUT1
PG10.Signal=GPIO_Output
PG11.GPIO_Label=DIRECT_OUT2
PG11.Signal=GPIO_Output
PG12.GPIO_Label=DIRECT_OUT3
PG12.Signal=GPIO_Output
PG13.GPIO_Label=DIRECT_OUT4
PG13.Signal=GPIO_Output
PG14.GPIO_Label=SCIE_RX
PG14.Mode=Asynchronous
PG14.Signal=USART6_TX
PG15.GPIO_Label=MOTOR_ON
PG15.Signal=GPIO_Output
PG2.GPIO_Label=SPARE_IN7
PG2.Signal=GPIO_Input
PG3.GPIO_Label=SPARE_IN8
PG3.Signal=GPIO_Input
PG4.GPIO_Label=SPARE_IN9
PG4.Signal=GPIO_Input
PG6.GPIO_Label=PIO_GO
PG6.Signal=GPIO_Input
PG9.GPIO_Label=SCIE_TX
PG9.Mode=Asynchronous
PG9.Signal=USART6_RX
PH0/OSC_IN.Mode=HSE-External-Oscillator
PH0/OSC_IN.Signal=RCC_OSC_IN
PH1/OSC_OUT.Mode=HSE-External-Oscillator
PH1/OSC_OUT.Signal=RCC_OSC_OUT
PH12.GPIO_Label=DIRECT_OUT5
PH12.Signal=GPIO_Output
PH13.GPIO_Label=DIRECT_OUT6
PH13.Signal=GPIO_Output
PH14.GPIO_Label=DIRECT_OUT7
PH14.Signal=GPIO_Output
PH15.GPIO_Label=DIRECT_OUT8
PH15.Signal=GPIO_Output
PH2.GPIO_Label=DAC_CLR
PH2.Signal=GPIO_Output
PH3.GPIO_Label=DAC_BIN
PH3.Signal=GPIO_Output
PH6.GPIO_Label=MT1_ABS_SCK
PH6.Signal=GPIO_Output
PH7.GPIO_Label=MT1_ABS_DATA
PH7.Signal=GPIO_Input
PH8.GPIO_Label=ENC_SEL1
PH8.Signal=GPIO_Output
PH9.GPIO_Label=ENC_SEL2
PH9.Signal=GPIO_Output
PI0.GPIO_Label=DAC_NSS
PI0.GPIO_Speed=GPIO_SPEED_FREQ_LOW
PI0.Signal=GPIO_Output
PI1.Mode=TX_Only_Simplex_Unidirect_Master
PI1.Signal=SPI2_SCK
PI10.GPIO_Label=KEY_IN3
PI10.Signal=GPIO_Input
PI11.GPIO_Label=KEY_IN4
PI11.Signal=GPIO_Input
PI12.GPIO_Label=KEY_IN5
PI12.Signal=GPIO_Input
PI13.GPIO_Label=KEY_IN6
PI13.Signal=GPIO_Input
PI14.GPIO_Label=KEY_IN7
PI14.Signal=GPIO_Input
PI15.GPIO_Label=KEY_IN8
PI15.Signal=GPIO_Input
PI3.Mode=TX_Only_Simplex_Unidirect_Master
PI3.Signal=SPI2_MOSI
PI5.GPIO_Label=LED_BLUE
PI5.Signal=S_TIM8_CH1
PI6.GPIO_Label=LED_RED
PI6.Signal=S_TIM8_CH2
PI7.GPIO_Label=LED_GREEN
PI7.Signal=S_TIM8_CH3
PI8.GPIO_Label=KEY_IN1
PI8.Signal=GPIO_Input
PI9.GPIO_Label=KEY_IN2
PI9.Signal=GPIO_Input
PJ0.GPIO_Label=TIM1_OUT1
PJ0.Signal=GPIO_Input
PJ1.GPIO_Label=TIM1_OUT2
PJ1.Signal=GPIO_Input
PJ10.GPIO_Label=PIO_IN3
PJ10.Signal=GPIO_Input
PJ11.GPIO_Label=PIO_IN4
PJ11.Signal=GPIO_Input
PJ12.GPIO_Label=PIO_IN5
PJ12.Signal=GPIO_Input
PJ13.GPIO_Label=PIO_IN6
PJ13.Signal=GPIO_Input
PJ14.GPIO_Label=PIO_IN7
PJ14.Signal=GPIO_Input
PJ15.GPIO_Label=PIO_IN8
PJ15.Signal=GPIO_Input
PJ2.GPIO_Label=TIM1_OUT3
PJ2.Signal=GPIO_Input
PJ3.GPIO_Label=TIM1_OUT4
PJ3.Signal=GPIO_Input
PJ4.GPIO_Label=TIM2_OUT1
PJ4.Signal=GPIO_Input
PJ5.GPIO_Label=TIM2_OUT2
PJ5.Signal=GPIO_Input
PJ6.GPIO_Label=TIM2_OUT3
PJ6.Signal=GPIO_Input
PJ7.GPIO_Label=TIM2_OUT4
PJ7.Signal=GPIO_Input
PJ8.GPIO_Label=PIO_IN1
PJ8.Signal=GPIO_Input
PJ9.GPIO_Label=PIO_IN2
PJ9.Signal=GPIO_Input
PK0.GPIO_Label=ATTACH1_UP_IN
PK0.Signal=GPIO_Input
PK1.GPIO_Label=ATTACH1_DOWN_IN
PK1.Signal=GPIO_Input
PK2.GPIO_Label=ATTACH2_UP_IN
PK2.Signal=GPIO_Input
PK3.GPIO_Label=ATTACH2_DOWN_IN
PK3.Signal=GPIO_Input
PK4.GPIO_Label=MT1_ABS_RESET
PK4.Signal=GPIO_Output
PK5.GPIO_Label=MT3_ABS_RESET
PK5.Signal=GPIO_Output
PK6.GPIO_Label=MARK1_IN
PK6.Signal=GPIO_Input
PK7.GPIO_Label=MARK2_IN
PK7.Signal=GPIO_Input
ProjectManager.HeapSize=0x200
ProjectManager.StackSize=0x400
ProjectManager.TargetToolchain=STM32CubeIDE
RCC.48MHZClocksFreq_Value=45000000
RCC.AHBFreq_Value=180000000
RCC.APB1CLKDivider=RCC_HCLK_DIV4
RCC.APB1Freq_Value=45000000
RCC.APB1TimFreq_Value=90000000
RCC.APB2CLKDivider=RCC_HCLK_DIV2
RCC.APB2Freq_Value=90000000
RCC.APB2TimFreq_Value=180000000
RCC.CortexFreq_Value=180000000
RCC.HCLKFreq_Value=180000000
RCC.HSE_VALUE=25000000
RCC.HSI_VALUE=16000000
RCC.LSE_VALUE=32768
RCC.PLLM=15
RCC.PLLN=216
RCC.PLLQ=8
RCC.PLLSourceVirtual=RCC_PLLSOURCE_HSE
RCC.RCC_RTC_Clock_Source=RCC_RTCCLKSOURCE_HSE_DIV25
RCC.RCC_RTC_Clock_SourceVirtual=RCC_RTCCLKSOURCE_LSE
RCC.RCC_RTC_Clock_Source_FROM_HSE=RCC_RTCCLKSOURCE_HSE_DIV25
RCC.SYSCLKFreq_VALUE=180000000
RCC.SYSCLKSource=RCC_SYSCLKSOURCE_PLLCLK
RCC.VCOOutputFreq_Value=360000000
SH.ADCx_IN10.0=ADC1_IN10,IN10
SH.ADCx_IN11.0=ADC1_IN11,IN11
SH.ADCx_IN12.0=ADC1_IN12,IN12
SH.ADCx_IN13.0=ADC1_IN13,IN13
SH.ADCx_IN14.0=ADC1_IN14,IN14
SH.FMC_A0.0=FMC_A0,5b-a1
SH.FMC_A1.0=FMC_A1,5b-a1
SH.FMC_A2.0=FMC_A2,5b-a1
SH.FMC_A3.0=FMC_A3,5b-a1
SH.FMC_A4.0=FMC_A4,5b-a1
SH.FMC_D0_DA0.0=FMC_D0,8b-d1
SH.FMC_D1_DA1.0=FMC_D1,8b-d1
SH.FMC_D2_DA2.0=FMC_D2,8b-d1
SH.FMC_D3_DA3.0=FMC_D3,8b-d1
SH.FMC_D4_DA4.0=FMC_D4,8b-d1
SH.FMC_D5_DA5.0=FMC_D5,8b-d1
SH.FMC_D6_DA6.0=FMC_D6,8b-d1
SH.FMC_D7_DA7.0=FMC_D7,8b-d1
SH.FMC_NOE.0=FMC_NOE,Sram1
SH.FMC_NWE.0=FMC_NWE,Sram1
SH.S_TIM1_CH1.0=TIM1_CH1,Encoder_Interface
SH.S_TIM1_CH2.0=TIM1_CH2,Encoder_Interface
SH.S_TIM2_CH1_ETR.0=TIM2_CH1,Encoder_Interface
SH.S_TIM2_CH2.0=TIM2_CH2,Encoder_Interface
SH.S_TIM3_CH1.0=TIM3_CH1,Encoder_Interface
SH.S_TIM3_CH2.0=TIM3_CH2,Encoder_Interface
SH.S_TIM4_CH1.0=TIM4_CH1,Encoder_Interface
SH.S_TIM4_CH2.0=TIM4_CH2,Encoder_Interface
SH.S_TIM8_CH1.0=TIM8_CH1,PWM Generation1 CH1
SH.S_TIM8_CH2.0=TIM8_CH2,PWM Generation2 CH2
SH.S_TIM8_CH3.0=TIM8_CH3,PWM Generation3 CH3
SPI1.BaudRatePrescaler=SPI_BAUDRATEPRESCALER_256
SPI1.CalculateBaudRate=351.562 KBits/s
SPI1.Direction=SPI_DIRECTION_2LINES
SPI1.Mode=SPI_MODE_MASTER
SPI1.VirtualType=VM_MASTER
SPI2.CLKPolarity=SPI_POLARITY_HIGH
SPI2.CalculateBaudRate=22.5 MBits/s
SPI2.Direction=SPI_DIRECTION_2LINES
SPI2.Mode=SPI_MODE_MASTER
SPI2.VirtualType=VM_MASTER
TIM1.Period=0xffff
TIM1.Prescaler=1
TIM2.Period=0xffff
TIM2.Prescaler=1
TIM3.Period=0xffff
TIM3.Prescaler=1
TIM4.Period=0xffff
TIM4.Prescaler=1
TIM6.Period=44
TIM6.Prescaler=9999
TIM7.Period=224
TIM7.Prescaler=9999
TIM8.Channel-PWM\ Generation1\ CH1=TIM_CHANNEL_1
TIM8.Channel-PWM\ Generation2\ CH2=TIM_CHANNEL_2
TIM8.Channel-PWM\ Generation3\ CH3=TIM_CHANNEL_3
TIM8.Period=21000-1
TIM8.Prescaler=5-1
TIM8.Pulse-PWM\ Generation1\ CH1=20000-1
TIM8.Pulse-PWM\ Generation2\ CH2=5000-1
TIM8.Pulse-PWM\ Generation3\ CH3=5000-1
UART7.VirtualMode=Asynchronous
UART8.BaudRate=19200
UART8.VirtualMode=Asynchronous
USART1.VirtualMode=VM_ASYNC
USART2.BaudRate=115200
USART2.Parity=PARITY_NONE
USART2.VirtualMode=VM_ASYNC
USART2.WordLength=WORDLENGTH_8B
USART3.BaudRate=38400
USART3.VirtualMode=VM_ASYNC
USART6.VirtualMode=VM_ASYNC
VP_FATFS_VS_SDIO.Mode=SDIO
VP_TIM6_VS_ClockSourceINT.Mode=Enable_Timer
VP_TIM7_VS_ClockSourceINT.Mode=Enable_Timer
VP_TIM8_VS_ClockSourceINT.Mode=Internal
board=custom

// file: Core/Src/main.c
/* USER CODE BEGIN Header */
/**
  ******************************************************************************
  * @file           : main.c
  * @brief          : Main program body
  ******************************************************************************
  * @attention
  *
  * Copyright (c) 2022 STMicroelectronics.
  * All rights reserved.
  *
  * This software is licensed under terms that can be found in the LICENSE file
  * in the root directory of this software component.
  * If no LICENSE file comes with this software, it is provided AS-IS.
  *
  ******************************************************************************
  */
/* USER CODE END Header */
#include "main.h"
#include "adc.h"
#include "can.h"
#include "dma.h"
#include "fatfs.h"
#include "sdio.h"
#include "spi.h"
#include "tim.h"
#include "usart.h"
#include "gpio.h"
#include "fmc.h"

/* USER CODE BEGIN Includes */
#include "delay.h"

/* USER CODE END Includes */

void SystemClock_Config(void);

int main(void)
{

  /* MCU Configuration--------------------------------------------------------*/

  /* Reset of all peripherals, Initializes the Flash interface and the Systick. */
  HAL_Init();

  /* Configure the system clock */
  SystemClock_Config();

  /* Initialize all configured peripherals */
  MX_GPIO_Init();
  MX_DMA_Init();
  MX_CAN1_Init();
  MX_FMC_Init();
  MX_SPI1_Init();
  MX_UART7_Init();
  MX_UART8_Init();
  MX_USART1_UART_Init();
  MX_USART2_UART_Init();
  MX_USART3_UART_Init();
  MX_USART6_UART_Init();
  MX_TIM1_Init();
  MX_TIM2_Init();
  MX_TIM3_Init();
  MX_TIM4_Init();
  MX_TIM6_Init();
  MX_TIM7_Init();
  MX_TIM8_Init();
  MX_SPI2_Init();
  MX_SDIO_SD_Init();
  MX_FATFS_Init();
  MX_ADC1_Init();
  MX_CAN2_Init();

  /* Infinite loop */
  while (1)
  {
    HAL_GPIO_TogglePin(DIRECT_OUT2_GPIO_Port, DIRECT_OUT2_Pin);
    uDelay(1000);
  }
}

void SystemClock_Config(void)
{
  RCC_OscInitTypeDef RCC_OscInitStruct = {0};
  RCC_ClkInitTypeDef RCC_ClkInitStruct = {0};

  /** Configure the main internal regulator output voltage
  */
  __HAL_RCC_PWR_CLK_ENABLE();
  __HAL_PWR_VOLTAGESCALING_CONFIG(PWR_REGULATOR_VOLTAGE_SCALE1);

  /** Initializes the RCC Oscillators according to the specified parameters
  * in the RCC_OscInitTypeDef structure.
  */
  RCC_OscInitStruct.OscillatorType = RCC_OSCILLATORTYPE_HSE;
  RCC_OscInitStruct.HSEState = RCC_HSE_ON;
  RCC_OscInitStruct.PLL.PLLState = RCC_PLL_ON;
  RCC_OscInitStruct.PLL.PLLSource = RCC_PLLSOURCE_HSE;
  RCC_OscInitStruct.PLL.PLLM = 15;
  RCC_OscInitStruct.PLL.PLLN = 216;
  RCC_OscInitStruct.PLL.PLLP = RCC_PLLP_DIV2;
  RCC_OscInitStruct.PLL.PLLQ = 8;
  if (HAL_RCC_OscConfig(&RCC_OscInitStruct) != HAL_OK)
  {
    Error_Handler();
  }

  /** Activate the Over-Drive mode
  */
  if (HAL_PWREx_EnableOverDrive() != HAL_OK)
  {
    Error_Handler();
  }

  /** Initializes the CPU, AHB and APB buses clocks
  */
  RCC_ClkInitStruct.ClockType = RCC_CLOCKTYPE_HCLK|RCC_CLOCKTYPE_SYSCLK
                              |RCC_CLOCKTYPE_PCLK1|RCC_CLOCKTYPE_PCLK2;
  RCC_ClkInitStruct.SYSCLKSource = RCC_SYSCLKSOURCE_PLLCLK;
  RCC_ClkInitStruct.AHBCLKDivider = RCC_SYSCLK_DIV1;
  RCC_ClkInitStruct.APB1CLKDivider = RCC_HCLK_DIV4;
  RCC_ClkInitStruct.APB2CLKDivider = RCC_HCLK_DIV2;

  if (HAL_RCC_ClockConfig(&RCC_ClkInitStruct, FLASH_LATENCY_5) != HAL_OK)
  {
    Error_Handler();
  }
}

void Error_Handler(void)
{
  __disable_irq();
  while (1)
  {
  }
}
